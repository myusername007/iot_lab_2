## main/Kconfig.projbuild
```kconfig
menu "Example Configuration"

    config WIFI_SSID
        string "WiFi SSID"
        default "MyHotspot"

    config WIFI_PASSWORD
        string "WiFi Password"
        default "12345678"

    config MQTT_BROKER_URI
        string "MQTT Broker URI"
        default "mqtt://192.168.137.1:1883"

endmenu
```
